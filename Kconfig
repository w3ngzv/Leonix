## arch/arm/Kconfig
```kconfig
# SPDX-License-Identifier: GPL-2.0-only
config ARM
	def_bool y
	help
	  Leonix runs on an STM32F103C8 such as the Blue Pill, from the
	  start of its Flash, with USART1 on PA9 and PA10 as the console.

config USART_CONSOLE
	def_bool y
	help
	  USART1 of the STM32F103 at 115200 baud, on PA9 (TX) and PA10
	  (RX), in arch/arm/usart.c.  It carries ttyS0 and the kernel log.
```

## arch/avr/Kconfig
```kconfig
# SPDX-License-Identifier: GPL-2.0-only
config AVR
	def_bool y
	help
	  Leonix runs on the ATmega32U4 of the Arduino Leonardo, behind the
	  Caterina bootloader.

config USB_CDC_ACM
	def_bool y
	help
	  The ATmega32U4's USB controller as a CDC-ACM serial port, in
	  arch/avr/usb.c.  It carries ttyACM0 and the kernel log.
```

## drivers/Kconfig
```kconfig
# SPDX-License-Identifier: GPL-2.0-only
menu "Device Drivers"

config EEPROM_LXFS
	def_bool AVR
	help
	  lxfs on the ATmega32U4's EEPROM, in drivers/eeprom.c.

config FLASH_LXFS
	def_bool ARM
	help
	  lxfs on the last pages of the STM32F103's Flash, in
	  drivers/stm32_flash.c.

config I2C
	bool "I2C bus master"
	depends on AVR
	help
	  The ATmega32U4's two-wire interface as an I2C bus master, on D2
	  (SDA) and D3 (SCL), in arch/avr/i2c.c.  Only the HD44780 display
	  uses it.

config HD44780
	bool "HD44780 character LCD on a PCF8574 backpack"
	depends on I2C
	help
	  A 16x2 HD44780 display behind a PCF8574 I2C expander.  A task
	  shows the idle share and the uptime on it once a second, and
	  panic() writes its reason there.

	  Without it the same task only reports stack usage to the kernel
	  log.

config SWD
	bool "Serial Wire Debug host"
	depends on AVR
	help
	  An SWD host on D8 (SWCLK) and D9 (SWDIO), for reading the
	  identification registers of an STM32F1 through /dev/swd.

config SWD_DAP
	bool "/dev/dap: target memory and run control"
	depends on SWD
	help
	  Memory reads and writes, halt, run and reset of the target, one
	  command per line written to /dev/dap, for a script on the host.
	  Also measures a square wave on D13 with Timer3.

config TTP229
	bool "TTP229 touch keypad"
	depends on AVR
	help
	  A TTP229 16-key capacitive keypad, such as the HW-136 board, on
	  A0 (SCL) and A1 (SDO), as /dev/keypad.  Each read returns one
	  character per key touched, '1' to '9' and 'a' to 'g' for keys 1
	  to 16.  The board must be set to 16-key mode, P1 pin 3 shorted.

endmenu
```

## fs/Kconfig
```kconfig
# SPDX-License-Identifier: GPL-2.0-only
menu "File systems"

config LXFS_V1_UPGRADE
	bool "Upgrade lxfs version 1 in place"
	default y
	help
	  Kernels up to the one that added the lxfs log wrote version 1,
	  which kept file data in the blocks the log now takes.  With this
	  option the first mount moves those blocks and writes version 2;
	  without it a device holding version 1 is left as it is and not
	  mounted.  The upgrade takes about 950 bytes of flash on the AVR,
	  which can be had back once no device holds version 1.

endmenu
```

## lib/Kconfig.debug
```kconfig
# SPDX-License-Identifier: GPL-2.0-only
menu "Kernel hacking"

menu "printk and dmesg options"

config CONSOLE_LOGLEVEL_DEFAULT
	int "Default console loglevel (1-15)"
	range 1 15
	default "7"
	help
	  Messages of a level below this number are sent to the console;
	  dmesg shows every level.  The default 7 leaves out KERN_DEBUG
	  only, as in Linux.

config MESSAGE_LOGLEVEL_DEFAULT
	int "Default message log level (1-7)"
	range 1 7
	default "4"
	help
	  The level of a printk() that names none.  4 is KERN_WARNING, as
	  in Linux.

endmenu # "printk and dmesg options"

endmenu # Kernel hacking
```
